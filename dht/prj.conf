## CMakeLists.txt
```
# SPDX-License-Identifier: Apache-2.0

cmake_minimum_required(VERSION 3.20.0)

find_package(Zephyr REQUIRED HINTS $ENV{ZEPHYR_BASE})
project(dht)

target_sources(app PRIVATE src/main.c)
```

## sample.yaml
```
sample:
  description: dht sample, the simplest Zephyr
    application
  name: dht
common:
  tags: introduction
  integration_platforms:
    - native_posix
  harness: console
  harness_config:
    type: one_line
    regex:
      - "DHT! (.*)"
tests:
  sample.basic.helloworld:
    tags: introduction
```

## prj.conf
```kconfig
#
# prj.conf
#
CONFIG_LOG=y
CONFIG_LOG_MODE_DEFERRED=y
CONFIG_SENSOR_LOG_LEVEL_DBG=y

CONFIG_SENSOR=y
CONFIG_GPIO=y

# Need float format support
CONFIG_NEWLIB_LIBC=y
CONFIG_NEWLIB_LIBC_FLOAT_PRINTF=y
CONFIG_CBPRINTF_FP_SUPPORT=y
```

## boards/esp32.overlay
```dts
/ {
    leds {
        compatible = "gpio-leds";
        info_led: info_led {
            gpios = <&gpio0 2 GPIO_ACTIVE_HIGH>;
        };
    };

    dht22 {
		compatible = "aosong,dht";
		status = "okay";
		dio-gpios = <&gpio0 4 (GPIO_PULL_UP | GPIO_ACTIVE_LOW)>;
        dht22;
	};
};
```

## src/main.c
```c
/*
 * Copyright (c) 2012-2014 Wind River Systems, Inc.
 *
 * SPDX-License-Identifier: Apache-2.0
 */
#include <zephyr/device.h>
#include <zephyr/drivers/gpio.h>
#include <zephyr/drivers/sensor.h>
#include <zephyr/kernel.h>
#include <zephyr/logging/log.h>

LOG_MODULE_REGISTER(MAIN, LOG_LEVEL_DBG);

static const struct gpio_dt_spec InfoLed =
    GPIO_DT_SPEC_GET(DT_NODELABEL(info_led), gpios);

int main(void) {
    const struct device *const dht22 = DEVICE_DT_GET_ONE(aosong_dht);
    LOG_INF("Board: %s", CONFIG_BOARD);
    LOG_INF("sys_clock_hw_cycles_per_sec = %u", sys_clock_hw_cycles_per_sec());

    if (!device_is_ready(InfoLed.port)) {
        LOG_ERR("GPIO0 not ready");
        return (0);
    }

    if (!device_is_ready(dht22)) {
        LOG_ERR("DHT is not ready");
        return 0;
    }

    int ret = gpio_pin_configure_dt(&InfoLed, GPIO_OUTPUT_ACTIVE);
    if (0 != ret) {
        LOG_ERR("gpio configuration failed");
        return (0);
    }

    while (1) {
        k_sleep(K_SECONDS(5));

        int rc = sensor_sample_fetch(dht22);
        if (rc != 0) {
            LOG_ERR("Sensor fetch failed: %d", rc);
            continue;
        }

        struct sensor_value temperature;
        struct sensor_value humidity;

        rc = sensor_channel_get(dht22, SENSOR_CHAN_AMBIENT_TEMP, &temperature);
        if (rc == 0) {
            rc = sensor_channel_get(dht22, SENSOR_CHAN_HUMIDITY, &humidity);
        }
        if (rc != 0) {
            LOG_ERR("get failed: %d", rc);
        } else {
            LOG_INF("%.1f Cel ; %.1f RH", sensor_value_to_double(&temperature),
                    sensor_value_to_double(&humidity));
        }

        gpio_pin_toggle_dt(&InfoLed);
    }
}

/* ---------------------------------------------------------------------------
 * end of file
 * --------------------------------------------------------------------------*/
```
