## CMakeLists.txt
```
# SPDX-License-Identifier: Apache-2.0

cmake_minimum_required(VERSION 3.20.0)

find_package(Zephyr REQUIRED HINTS $ENV{ZEPHYR_BASE})
project(wifi_mqtt)

target_include_directories(app PRIVATE inc)

target_sources(app PRIVATE 
    src/main.c
    src/wifi_net.c
    src/mqtt_worker.c
)
```

## sample.yaml
```
sample:
  description: wifi mqtt sample, the simplest Zephyr
    application
  name: wifi_mqtt
common:
  tags: introduction
  integration_platforms:
    - native_posix
  harness: console
  harness_config:
    type: one_line
    regex:
      - "wifi mqtt! (.*)"
tests:
  sample.basic.helloworld:
    tags: introduction
```

## prj.conf
```kconfig
#
# prj.conf
#
###############################################################################
# SYSTEM
CONFIG_LOG=y
CONFIG_LOG_MODE_DEFERRED=y
CONFIG_COMMON_LIBC_MALLOC_ARENA_SIZE=16384

###############################################################################
# PERIPHERALS
CONFIG_GPIO=y

###############################################################################
# WIFI
CONFIG_WIFI=y
CONFIG_INIT_STACKS=y
CONFIG_NET_L2_WIFI_MGMT=y

CONFIG_NETWORKING=y
CONFIG_NET_IPV4=y
CONFIG_NET_IPV6=n
CONFIG_NET_UDP=y
CONFIG_NET_TCP=y
CONFIG_DNS_RESOLVER=y
CONFIG_DNS_RESOLVER_AI_MAX_ENTRIES=10
CONFIG_DNS_SERVER_IP_ADDRESSES=y
CONFIG_DNS_SERVER1="8.8.8.8"

CONFIG_NET_SOCKETS=y

# Use DHCP for IPv4
CONFIG_NET_DHCPV4=y

# Or assign a static IP address (useful for testing)
# Following line must be enabled, otherwise WiFi connection fails with -1.
CONFIG_NET_CONFIG_SETTINGS=y
#CONFIG_NET_CONFIG_NEED_IPV4=y
#CONFIG_NET_CONFIG_MY_IPV4_ADDR="192.168.0.12"
#CONFIG_NET_CONFIG_MY_IPV4_GW="192.168.0.254"
#CONFIG_NET_CONFIG_NEED_IPV6=y
#CONFIG_NET_CONFIG_MY_IPV6_ADDR="fe80::100"

# Enabling logging can be helpful for debugging
#CONFIG_NET_LOG=y
#CONFIG_WIFI_LOG_LEVEL_ERR=y
#CONFIG_NET_IPV6_LOG_LEVEL_DBG=y

CONFIG_NET_TX_STACK_SIZE=2048
CONFIG_NET_RX_STACK_SIZE=2048
CONFIG_NET_PKT_RX_COUNT=10
CONFIG_NET_PKT_TX_COUNT=10
CONFIG_NET_BUF_RX_COUNT=20
CONFIG_NET_BUF_TX_COUNT=20
CONFIG_NET_MAX_CONTEXTS=10

# Added to prevent error with missing #include <ethernet/eth_stats.h> for esp_wifi_drv.c
# Adding this line will cause CMAKE Warning: No SOURCES given to Zephyr library: drivers__ethernet
# Just ignore.
CONFIG_NET_L2_ETHERNET=y

# MQTT
CONFIG_MQTT_LIB=y
```

## src/main.c
```c
/* ---------------------------------------------------------------------------
 *  wifi_mqtt
 * ---------------------------------------------------------------------------
 *  Name: main.c
 * --------------------------------------------------------------------------*/
#include <stdint.h>
#include <zephyr/device.h>
#include <zephyr/drivers/gpio.h>
#include <zephyr/kernel.h>
#include <zephyr/logging/log.h>
#include <zephyr/net/mqtt.h>

#include "config_wifi.h"
#include "mqtt_worker.h"
#include "wifi_net.h"

LOG_MODULE_REGISTER(MAIN, LOG_LEVEL_DBG);

static const struct gpio_dt_spec InfoLed =
    GPIO_DT_SPEC_GET(DT_NODELABEL(info_led), gpios);

#define SUBSCRIBE_TOPIC "/test/mosquitto/pubsub/topic"
#define PUBLISH_TOPIC   "/test/mosquitto/publish/esp32"

void subs_cb(char *topic, uint16_t topic_len, char *payload,
             uint16_t payload_len) {
    LOG_INF("Topic: %s", topic);
    LOG_INF("Payload: %s", payload);
}

int main(void) {
    LOG_INF("Board: %s", CONFIG_BOARD);
    LOG_INF("sys_clock_hw_cycles_per_sec = %u", sys_clock_hw_cycles_per_sec());

    if (!device_is_ready(InfoLed.port)) {
        LOG_ERR("GPIO0 not ready");
        return (0);
    }

    int32_t ret = gpio_pin_configure_dt(&InfoLed, GPIO_OUTPUT_ACTIVE);
    if (0 != ret) {
        LOG_ERR("gpio configuration failed");
        return (0);
    }

    struct mqtt_topic subs_topic = {
        .topic = {.utf8 = (uint8_t *)SUBSCRIBE_TOPIC,
                  .size = strlen(SUBSCRIBE_TOPIC)},
        .qos = MQTT_QOS_0_AT_MOST_ONCE};
    struct mqtt_subscription_list subs_list = {
        .list = &subs_topic, .list_count = 1U, .message_id = 1U};
    mqtt_worker_init("test.mosquitto.org", 1883, &subs_list, subs_cb);

    wifi_net_init(WIFI_SSID, WIFI_PASS);

    int32_t lopp_cnt = 0;
    for (;;) {
        k_sleep(K_SECONDS(1));
        gpio_pin_toggle_dt(&InfoLed);

        lopp_cnt++;
        if (0 == lopp_cnt % 8) {
            mqtt_worker_publish_qos1(PUBLISH_TOPIC, "ESP32_TEST");
        }
    }
}

/* ---------------------------------------------------------------------------
 * end of file
 * --------------------------------------------------------------------------*/
```

## inc/config_wifi_template.h
```c
/* ---------------------------------------------------------------------------
 *  wifi
 * ---------------------------------------------------------------------------
 *  Name: config_wifi.h
 * --------------------------------------------------------------------------*/
#ifndef CONFIG_WIFI_H_
#define CONFIG_WIFI_H_

#define WIFI_SSID   "wifi_net_ssid"
#define WIFI_PASS   "Abb1234"

#endif /* CONFIG_WIFI_H_ */
/* ---------------------------------------------------------------------------
 * end of file
 * --------------------------------------------------------------------------*/
```

## inc/mqtt_worker.h
```c
/* ---------------------------------------------------------------------------
 *  mqtt
 * ---------------------------------------------------------------------------
 *  Name: mqtt_worker.h
 * --------------------------------------------------------------------------*/
#ifndef MQTT_WORKER_H_
#define MQTT_WORKER_H_

#include <stdint.h>
#include <zephyr/net/mqtt.h>

#define MQTT_WORKER_CLIENT_ID           ("zephyrux")
#define MQTT_WORKER_MAX_TOPIC_LEN       (128)
#define MQTT_WORKER_MAX_PAYLOAD_LEN     (256)
#define MQTT_WORKER_MAX_PUBLISH_LEN     (256)
#define MQTT_WORKER_PUBLISH_ACK_TIMEOUT (4) /* seconds */

typedef void (*subs_cb_t)(char *topic, uint16_t topic_len, char *payload,
                          uint16_t payload_len);

/**
 * @brief Initialize worker. All next action will be executed in separated
 * thread. Function is not blocked, to verify if driver is connected with broker
 * use api below.
 * @param hostname It can be name of host or string representation of ip addr.
 * @param port Broker port
 * @param subs Pointer to list of topics to be subscribed, NULL if no topics
 * should be subcribed
 * @param subs_cb Function to handle data incomming to subscribed topics, NULL
 * if not needed.
 */
void mqtt_worker_init(const char *hostname, int32_t port,
                      struct mqtt_subscription_list *subs, subs_cb_t subs_cb);

/**
 * @brief Publish data to given topic. Use in the same way as typical printf().
 * @param topic Topic where msg will be published
 */
int32_t mqtt_worker_publish_qos1(const char *topic, const char *fmt, ...);

/**
 * @brief Typically put to network disconnect callback to notify mqtt stack
 * about network absence. This will speed up reconnection process.
 */
void mqtt_worker_disconnect(void);

/**
 * @brief Make broker connection attempt.
 */
void mqtt_worker_connection_attempt(void);

#endif /* MQTT_WORKER_H_ */
/* ---------------------------------------------------------------------------
 * end of file
 * --------------------------------------------------------------------------*/
```

## src/mqtt_worker.c
```c
/* ---------------------------------------------------------------------------
 *  mqtt
 * ---------------------------------------------------------------------------
 *  Name: mqtt_worker.c
 * --------------------------------------------------------------------------*/
#include "mqtt_worker.h"

#include <stdarg.h>
#include <stdint.h>
#include <stdio.h>
#include <string.h>
#include <zephyr/kernel.h>
#include <zephyr/logging/log.h>
#include <zephyr/net/mqtt.h>
#include <zephyr/net/socketutils.h>

LOG_MODULE_REGISTER(MQTT, LOG_LEVEL_DBG);

typedef struct subs_data {
    uint8_t topic[MQTT_WORKER_MAX_TOPIC_LEN];
    uint16_t topic_len;
    uint8_t payload[MQTT_WORKER_MAX_PAYLOAD_LEN];
    uint16_t payload_len;
} subs_data_t;

typedef enum worker_state {
    DNS_RESOLVE,
    CONNECT_TO_BROKER,
    SUBSCRIBE,
    CONNECTED,
    DISCONNECTED
} worker_state_t;

static void mqtt_evt_handler(struct mqtt_client *const client,
                             const struct mqtt_evt *evt);
static int32_t wait_for_input(int32_t timeout);
static int32_t dns_resolve(void);
static int32_t connect_to_broker(void);
static int32_t input_handle(void);
static int32_t mqtt_worker_subscribe(void);

static void mqtt_proc(void *, void *, void *);
static void subscribe_proc(void *, void *, void *);

/* The mqtt client struct */
static struct mqtt_client ClientCtx;

/* MQTT Broker details. */
static struct sockaddr_storage Broker;

/* Buffers for MQTT client. */
static uint8_t RxBuffer[1024];
static uint8_t TxBuffer[1024];

static char BrokerHostnameStr[32];
static char BrokerAddrStr[16];
static char BrokerPortStr[32];
static int32_t BrokerPort = 0;
struct mqtt_subscription_list *SubsList = NULL;
static struct mqtt_publish_param PubData = {0};
static enum mqtt_evt_type LastEvt = 0;

static worker_state_t StateMachine = DNS_RESOLVE;
static char PublishBuffer[MQTT_WORKER_MAX_PUBLISH_LEN];

static bool Connected = false;
static bool DisconnectReqExternal = false;
static bool Subscribed = false;

static subs_cb_t SubsCb = NULL;

#define MQTT_NET_STACK_SIZE (2 * 1024)
#define MQTT_NET_PRIORITY   (5)
K_THREAD_DEFINE(MqttNetTid, MQTT_NET_STACK_SIZE, mqtt_proc, NULL, NULL, NULL,
                MQTT_NET_PRIORITY, 0, 0);

#define SUBSCRIBE_STACK_SIZE (2 * 1024)
#define SUBSCRIBE_PRIORITY   (5)
K_THREAD_DEFINE(SubsTid, SUBSCRIBE_STACK_SIZE, subscribe_proc, NULL, NULL, NULL,
                SUBSCRIBE_PRIORITY, 0, 0);

K_SEM_DEFINE(PublishAck, 0, 1);
K_MSGQ_DEFINE(SubsQueue, sizeof(subs_data_t *), 4, 4);
K_MEM_SLAB_DEFINE_STATIC(SubsQueueSlab, sizeof(subs_data_t), 4, 4);

void mqtt_worker_disconnect(void) {
    DisconnectReqExternal = true;
}

void mqtt_worker_connection_attempt(void) {
    StateMachine = DNS_RESOLVE;
}

int32_t mqtt_worker_publish_qos1(const char *topic, const char *fmt, ...) {
    int32_t res = -1;

    va_list args;
    va_start(args, fmt);

    if (!Connected || DisconnectReqExternal) {
        LOG_WRN("Cannot publish, client not connected");
        goto failed_done;
    }

    uint32_t len =
        vsnprintf(PublishBuffer, MQTT_WORKER_MAX_PUBLISH_LEN, fmt, args);

    PubData.message.payload.len = len;
    PubData.message.topic.topic.utf8 = (uint8_t *)topic;
    PubData.message.topic.topic.size = strlen((const char *)topic);
    PubData.message.topic.qos = MQTT_QOS_1_AT_LEAST_ONCE;
    PubData.message_id += 1U;

    struct mqtt_client *client = &ClientCtx;

    k_sem_take(&PublishAck, K_NO_WAIT);
    res = mqtt_publish(client, &PubData);
    if (0 != res) {
        LOG_ERR("could not publish, err %d", res);
        goto failed_done;
    }

    res = k_sem_take(&PublishAck, K_SECONDS(MQTT_WORKER_PUBLISH_ACK_TIMEOUT));
    if (0 != res) {
        LOG_ERR("publish ack timeout");
    }

failed_done:
    va_end(args);
    return (res);
}

void mqtt_worker_init(const char *hostname, int32_t port,
                      struct mqtt_subscription_list *subs, subs_cb_t subs_cb) {
    struct mqtt_client *client = &ClientCtx;

    SubsCb = subs_cb;
    SubsList = subs;
    strncpy(BrokerHostnameStr, hostname, sizeof(BrokerHostnameStr));
    BrokerPort = port;
    snprintf(BrokerPortStr, sizeof(BrokerPortStr), "%d", port);

    mqtt_client_init(client);

    /* MQTT client configuration */
    client->broker = &Broker;
    client->evt_cb = mqtt_evt_handler;
    client->protocol_version = MQTT_VERSION_3_1_1;
    client->client_id.utf8 = (uint8_t *)MQTT_WORKER_CLIENT_ID;
    client->client_id.size = strlen(MQTT_WORKER_CLIENT_ID);
    client->password = NULL;
    client->user_name = NULL;

    /* MQTT buffers configuration */
    client->rx_buf = RxBuffer;
    client->rx_buf_size = sizeof(RxBuffer);
    client->tx_buf = TxBuffer;
    client->tx_buf_size = sizeof(TxBuffer);

    PubData.message.payload.data = (uint8_t *)PublishBuffer;
    PubData.message_id = 1U;
    PubData.dup_flag = 0U;
    PubData.retain_flag = 1U;
}

static void subscribe_proc(void *arg1, void *arg2, void *arg3) {
    subs_data_t *subs_data = NULL;
    for (;;) {
        if (0 == k_msgq_get(&SubsQueue, &subs_data, K_SECONDS(1))) {
            /* handle incomming message here*/
            if (NULL != SubsCb) {
                SubsCb((char *)subs_data->topic, subs_data->topic_len,
                       (char *)subs_data->payload, subs_data->payload_len);
            }
            k_mem_slab_free(&SubsQueueSlab, (void **)&subs_data);
        }
    }
}

static void mqtt_proc(void *arg1, void *arg2, void *arg3) {
    StateMachine = DISCONNECTED;
    Connected = false;
    for (;;) {
        switch (StateMachine) {
            case DNS_RESOLVE: {
                LOG_INF("DNS_RESOLVE");
                int32_t res = dns_resolve();
                if (0 == res) {
                    StateMachine = CONNECT_TO_BROKER;
                } else {
                    k_sleep(K_SECONDS(2));
                }
                break;
            }
            case CONNECT_TO_BROKER: {
                LOG_INF("CONNECT_TO_BROKER");
                static int32_t err_trials = 0;
                int32_t res = connect_to_broker();
                if (0 == res) {
                    LOG_INF("MQTT client connected!");
                    StateMachine = SUBSCRIBE;
                    err_trials = 0;
                } else {
                    err_trials++;
                    if (4 == err_trials) {
                        StateMachine = DNS_RESOLVE;
                        err_trials = 0;
                    }
                    k_sleep(K_SECONDS(2));
                }
                break;
            }
            case SUBSCRIBE: {
                LOG_INF("SUBSCRIBE");
                static int32_t err_trials = 0;
                int32_t res = mqtt_worker_subscribe();
                if (0 == res) {
                    LOG_INF("Subscribe done");
                    StateMachine = CONNECTED;
                    err_trials = 0;
                } else {
                    err_trials++;
                    if (4 == err_trials) {
                        StateMachine = DNS_RESOLVE;
                        err_trials = 0;
                    }
                }
            }
            case CONNECTED: {
                LOG_INF("CONNECTED");
                int32_t res = input_handle();
                if (0 != res) {
                    StateMachine = DISCONNECTED;
                }
                break;
            }
            case DISCONNECTED: {
                k_sleep(K_MSEC(10));
            }
            default: {
                break;
            }
        }
    }
}

static int32_t mqtt_worker_subscribe(void) {
    struct mqtt_client *client = &ClientCtx;
    int32_t res = 0;

    if (NULL == SubsList) {
        LOG_WRN("Subscription list empty");
        goto failed_done;
    }

    Subscribed = false;
    res = mqtt_subscribe(client, SubsList);
    if (0 != res) {
        LOG_ERR("Failed to subscribe topics, err %d", res);
        goto failed_done;
    }

    while (true) {
        LastEvt = 0xFF;
        res = wait_for_input(4000);
        if (0 < res) {
            mqtt_input(client);
            if (LastEvt != MQTT_EVT_SUBACK && LastEvt != 0xFF) {
                LOG_WRN("Unexpected event got, try again");
                continue;
            }
        }
        break;
    }

    if (!Subscribed) {
        LOG_ERR("Subscribe timeout");
    } else {
        res = 0;
    }

failed_done:
    return (res);
}

static int32_t wait_for_input(int32_t timeout) {
#if defined(CONFIG_MQTT_LIB_TLS)
    struct zsock_pollfd fds[1] = {
        [0] =
            {
                .fd = ClientCtx.transport.tls.sock,
                .events = ZSOCK_POLLIN,
                .revents = 0,
            },
    };
#else
    struct zsock_pollfd fds[1] = {
        [0] =
            {
                .fd = ClientCtx.transport.tcp.sock,
                .events = ZSOCK_POLLIN,
                .revents = 0,
            },
    };
#endif

    int32_t res = zsock_poll(fds, 1, timeout);
    if (0 > res) {
        LOG_ERR("zsock_poll event err %d", res);
    }

    return (res);
}

static int32_t connect_to_broker(void) {
    struct mqtt_client *client = &ClientCtx;
    int32_t res = 0;

    DisconnectReqExternal = false;
    Connected = false;
    res = mqtt_connect(client);
    if (res != 0) {
        LOG_ERR("mqtt_connect, err %d", res);
        mqtt_disconnect(client);
        goto failed_done;
    }

    res = wait_for_input(2000);
    if (0 < res) {
        mqtt_input(client);
    }

    if (!Connected) {
        LOG_ERR("Connection timeout, abort...");
        mqtt_abort(client);
        res = -1;
    } else {
        res = 0;
    }

failed_done:
    return (res);
}

static int32_t input_handle(void) {
    int32_t res = 0;
    struct mqtt_client *client = &ClientCtx;
    static int64_t next_alive = INT64_MIN;

    /* idle and process messages */
    int64_t uptime_ms = k_uptime_get();
    if (uptime_ms < next_alive) {
        res = wait_for_input(1 * MSEC_PER_SEC);
        if (0 < res) {
            mqtt_input(client);
        }

        if (!Connected) {
            res = -1;
            goto failed_done;
        }

        if (DisconnectReqExternal) {
            mqtt_disconnect(client);
            Connected = false;
            res = -1;
            goto failed_done;
        }
    } else {
        LOG_INF("Keepalive...");
        mqtt_live(client);
        next_alive = uptime_ms + (60 * MSEC_PER_SEC);
    }

    res = 0; /* success done */

failed_done:
    return (res);
}

static int32_t dns_resolve(void) {
    static struct zsock_addrinfo hints;
    struct zsock_addrinfo *haddr;
    int32_t res = 0;
    uint8_t *in_addr = NULL;

    memset(&Broker, 0, sizeof(struct sockaddr_storage));
    struct sockaddr_in *ipv4_broker = (struct sockaddr_in *)&Broker;

    ipv4_broker->sin_family = AF_INET;
    ipv4_broker->sin_port = htons(BrokerPort);
    res = zsock_inet_pton(AF_INET, BrokerHostnameStr, &ipv4_broker->sin_addr);
    if (0 != res) {
        in_addr = ipv4_broker->sin_addr.s4_addr;
        LOG_INF("Broker addr %d.%d.%d.%d", in_addr[0], in_addr[1], in_addr[2],
                in_addr[3]);
        res = 0; /* 0 - success, string ip address delivered, dns not needed */
        goto resolve_done;
    }

    hints.ai_family = AF_INET;
    hints.ai_socktype = SOCK_STREAM;
    hints.ai_protocol = 0;

    res = net_getaddrinfo_addr_str(BrokerHostnameStr, BrokerPortStr, &hints,
                                   &haddr);
    if (0 != res) {
        LOG_ERR("Unable to get address of broker, err %d", res);
        goto resolve_done;
    }

    ipv4_broker->sin_family = AF_INET;
    ipv4_broker->sin_port = htons(BrokerPort);
    net_ipaddr_copy(&ipv4_broker->sin_addr, &net_sin(haddr->ai_addr)->sin_addr);
    in_addr = ipv4_broker->sin_addr.s4_addr;
    LOG_INF("Broker addr %d.%d.%d.%d", in_addr[0], in_addr[1], in_addr[2],
            in_addr[3]);

resolve_done:
    return (res);
}

static void mqtt_evt_handler(struct mqtt_client *const client,
                             const struct mqtt_evt *evt) {
    LOG_INF("mqtt_evt_handler");
    LastEvt = evt->type;

    switch (evt->type) {
        case MQTT_EVT_SUBACK: {
            LOG_INF("MQTT_EVT_SUBACK");
            Subscribed = true;
            break;
        }
        case MQTT_EVT_UNSUBACK: {
            LOG_INF("MQTT_EVT_UNSUBACK");
            break;
        }
        case MQTT_EVT_CONNACK: {
            if (evt->result != 0) {
                LOG_ERR("MQTT connect failed %d", evt->result);
            } else {
                Connected = true;
            }
            break;
        }
        case MQTT_EVT_DISCONNECT: {
            LOG_INF("MQTT client disconnected %d", evt->result);
            Connected = false;
            break;
        }
        case MQTT_EVT_PUBLISH: {
            LOG_INF("MQTT_EVT_PUBLISH");
            subs_data_t *subs_data = NULL;
            const struct mqtt_publish_param *pub = &evt->param.publish;
            int32_t len = pub->message.payload.len;
            int32_t bytes_read = INT32_MIN;
            bool cleanup_and_break = false;

            LOG_INF("MQTT publish received %d, %d bytes", evt->result, len);
            LOG_INF("   id: %d, qos: %d", pub->message_id,
                    pub->message.topic.qos);
            LOG_INF("   topic: %s", pub->message.topic.topic.utf8);

            if (0 != k_mem_slab_alloc(&SubsQueueSlab, (void **)&subs_data,
                                      K_MSEC(1000))) {
                LOG_ERR("Get free subs slab failed");
                cleanup_and_break = true;
            }

            if (MQTT_WORKER_MAX_PAYLOAD_LEN < (pub->message.payload.len + 1)) {
                LOG_ERR("Payload to long %d", len);
                cleanup_and_break = true;
            }

            if (MQTT_WORKER_MAX_TOPIC_LEN < pub->message.topic.topic.size) {
                LOG_ERR("Topic to long %d", pub->message.topic.topic.size);
                cleanup_and_break = true;
            }

            if (!Connected) {
                LOG_WRN("Not connected yet");
                cleanup_and_break = true;
            }

            if (cleanup_and_break) {
                uint8_t tmp[32];
                if (NULL != subs_data) {
                    k_mem_slab_free(&SubsQueueSlab, (void **)&subs_data);
                }

                while (len) { /* cleanup mqtt socket buffer */
                    bytes_read = mqtt_read_publish_payload_blocking(
                        client, tmp, len >= 32 ? 32 : len);
                    if (0 > bytes_read) {
                        break;
                    }
                    len -= bytes_read;
                }
                break;
            }

            /* assuming the config message is textual */
            int32_t read_idx = 0;
            while (len) {
                bytes_read = mqtt_read_publish_payload_blocking(
                    client, subs_data->payload + read_idx,
                    len >= 32 ? 32 : len);

                if (0 > bytes_read) {
                    LOG_ERR("Failure to read payload");
                    break;
                }

                len -= bytes_read;
                read_idx += bytes_read;
            }

            subs_data->payload[pub->message.payload.len] = '\0';
            subs_data->payload_len = pub->message.payload.len;
            subs_data->topic_len = pub->message.topic.topic.size;
            if (0 <= bytes_read) {
                LOG_INF("   payload: %s", subs_data->payload);
                memcpy(subs_data->topic, pub->message.topic.topic.utf8,
                       subs_data->topic_len);
                subs_data->topic[subs_data->topic_len] = '\0';
                int32_t res = k_msgq_put(&SubsQueue, &subs_data, K_MSEC(1000));
                if (0 != res) {
                    LOG_ERR("Timeout to put subs msg into queue");
                }
            }

            break;
        }
        case MQTT_EVT_PUBACK: {
            if (evt->result != 0) {
                LOG_ERR("PUBACK error %d", evt->result);
            } else {
                LOG_INF("PUBACK packet id: %u", evt->param.puback.message_id);
                k_sem_give(&PublishAck);
            }
            break;
        }
        case MQTT_EVT_PUBREC: {
            LOG_INF("MQTT_EVT_PUBREC");
            break;
        }
        case MQTT_EVT_PUBREL: {
            LOG_INF("MQTT_EVT_PUBREL");
            break;
        }
        case MQTT_EVT_PUBCOMP: {
            LOG_INF("MQTT_EVT_PUBCOMP");
            break;
        }
        case MQTT_EVT_PINGRESP: {
            LOG_INF("MQTT_EVT_PINGRESP");
            break;
        }
        default: {
            LOG_WRN("MQTT event unknown %d", evt->type);
            break;
        }
    }
}

/* ---------------------------------------------------------------------------
 * end of file
 * --------------------------------------------------------------------------*/
```

## src/wifi_net.c
```c
/* ---------------------------------------------------------------------------
 *  wifi
 * ---------------------------------------------------------------------------
 *  Name: wifi_net.c
 * --------------------------------------------------------------------------*/
#include "wifi_net.h"

#include <errno.h>
#include <zephyr/kernel.h>
#include <zephyr/logging/log.h>
#include <zephyr/net/net_event.h>
#include <zephyr/net/net_if.h>
#include <zephyr/net/wifi_mgmt.h>

#include "mqtt_worker.h"

LOG_MODULE_REGISTER(WIFI, LOG_LEVEL_DBG);

static K_SEM_DEFINE(wifi_connected, 0, 1);
static K_SEM_DEFINE(ipv4_address_obtained, 0, 1);

static struct net_mgmt_event_callback wifi_cb;
static struct net_mgmt_event_callback ipv4_cb;

static void handle_wifi_connect_result(struct net_mgmt_event_callback *cb);
static void handle_wifi_disconnect_result(struct net_mgmt_event_callback *cb);
static void handle_ipv4_result(struct net_if *iface);
static void wifi_mgmt_event_handler(struct net_mgmt_event_callback *cb,
                                    uint32_t mgmt_event, struct net_if *iface);
static void wifi_status(void);
static void reconnect_work_handler(struct k_work *work);
static void reconnect_timer_handler(struct k_timer *dummy);

K_WORK_DEFINE(ReconnectWork, reconnect_work_handler);
K_TIMER_DEFINE(ReconnectTimer, reconnect_timer_handler, NULL);

static struct wifi_connect_req_params WifiInit = {0};

void wifi_net_init(char *ssid, char *passwd) {
    net_mgmt_init_event_callback(
        &wifi_cb, wifi_mgmt_event_handler,
        NET_EVENT_WIFI_CONNECT_RESULT | NET_EVENT_WIFI_DISCONNECT_RESULT);

    net_mgmt_init_event_callback(&ipv4_cb, wifi_mgmt_event_handler,
                                 NET_EVENT_IPV4_ADDR_ADD);

    net_mgmt_add_event_callback(&wifi_cb);
    net_mgmt_add_event_callback(&ipv4_cb);

    struct net_if *iface = net_if_get_default();
    WifiInit.ssid = (const uint8_t *)ssid;
    WifiInit.ssid_length = strlen(ssid);

    if (NULL != passwd) {
        WifiInit.security = WIFI_SECURITY_TYPE_PSK;
        WifiInit.psk = (uint8_t *)passwd;
        WifiInit.psk_length = strlen(passwd);
    }

    WifiInit.channel = WIFI_CHANNEL_ANY;
    WifiInit.band = WIFI_FREQ_BAND_2_4_GHZ;
    WifiInit.mfp = WIFI_MFP_OPTIONAL;

    LOG_INF("Connecting to SSID: %s", WifiInit.ssid);

    if (net_mgmt(NET_REQUEST_WIFI_CONNECT, iface, &WifiInit,
                 sizeof(struct wifi_connect_req_params))) {
        LOG_ERR("WiFi Connection Request Failed");
    }
}

static void reconnect_timer_handler(struct k_timer *dummy) {
    k_work_submit(&ReconnectWork);
}

static void reconnect_work_handler(struct k_work *work) {
    struct net_if *iface = net_if_get_default();

    LOG_INF("Make wifi connection attempt...");
    if (net_mgmt(NET_REQUEST_WIFI_CONNECT, iface, &WifiInit,
                 sizeof(struct wifi_connect_req_params))) {
        LOG_ERR("WiFi Connection Request Failed");
    }
}

static void handle_wifi_connect_result(struct net_mgmt_event_callback *cb) {
    const struct wifi_status *status = (const struct wifi_status *)cb->info;

    if (status->status) {
        LOG_INF("Connection request failed (%d)", status->status);
        k_timer_start(&ReconnectTimer, K_SECONDS(4), K_NO_WAIT);
    } else {
        LOG_INF("Connected");
        wifi_status();
        mqtt_worker_connection_attempt();
    }
}

static void handle_wifi_disconnect_result(struct net_mgmt_event_callback *cb) {
    const struct wifi_status *status = (const struct wifi_status *)cb->info;

    if (status->status) {
        LOG_INF("Disconnection request (%d)", status->status);
    } else {
        LOG_INF("Disconnected");
    }
    mqtt_worker_disconnect();
    /* one shot timer */
    k_timer_start(&ReconnectTimer, K_SECONDS(4), K_NO_WAIT);
}

static void handle_ipv4_result(struct net_if *iface) {
    int32_t i = 0;

    for (i = 0; i < NET_IF_MAX_IPV4_ADDR; i++) {
        char buf[NET_IPV4_ADDR_LEN];

        if (iface->config.ip.ipv4->unicast[i].addr_type != NET_ADDR_DHCP) {
            continue;
        }

        LOG_INF("IPv4 address: %s",
                net_addr_ntop(
                    AF_INET, &iface->config.ip.ipv4->unicast[i].address.in_addr,
                    buf, sizeof(buf)));
        LOG_INF("Subnet: %s",
                net_addr_ntop(AF_INET, &iface->config.ip.ipv4->netmask, buf,
                              sizeof(buf)));
        LOG_INF("Router: %s", net_addr_ntop(AF_INET, &iface->config.ip.ipv4->gw,
                                            buf, sizeof(buf)));
    }
}

static void wifi_mgmt_event_handler(struct net_mgmt_event_callback *cb,
                                    uint32_t mgmt_event, struct net_if *iface) {
    switch (mgmt_event) {
        case NET_EVENT_WIFI_CONNECT_RESULT: {
            handle_wifi_connect_result(cb);
            break;
        }
        case NET_EVENT_WIFI_DISCONNECT_RESULT: {
            handle_wifi_disconnect_result(cb);
            break;
        }
        case NET_EVENT_IPV4_ADDR_ADD: {
            handle_ipv4_result(iface);
            break;
        }
        default: {
            LOG_ERR("Unknown mgmt_event event: %d", mgmt_event);
            break;
        }
    }
}

static void wifi_status(void) {
    struct net_if *iface = net_if_get_default();

    struct wifi_iface_status status = {0};

    if (net_mgmt(NET_REQUEST_WIFI_IFACE_STATUS, iface, &status,
                 sizeof(struct wifi_iface_status))) {
        LOG_INF("WiFi Status Request Failed\n");
    }

    if (status.state >= WIFI_STATE_ASSOCIATED) {
        LOG_INF("SSID: %-32s", status.ssid);
        LOG_INF("Band: %s", wifi_band_txt(status.band));
        LOG_INF("Channel: %d", status.channel);
        LOG_INF("Security: %s", wifi_security_txt(status.security));
        LOG_INF("RSSI: %d", status.rssi);
    }
}

/* ---------------------------------------------------------------------------
 * end of file
 * --------------------------------------------------------------------------*/
```
