## CMakeLists.txt
```
# SPDX-License-Identifier: Apache-2.0

cmake_minimum_required(VERSION 3.20.0)

find_package(Zephyr REQUIRED HINTS $ENV{ZEPHYR_BASE})
project(rtc_sntp)

target_include_directories(app PRIVATE inc)

target_sources(app PRIVATE 
    src/main.c
    src/wifi_net.c
)
```

## sample.yaml
```
sample:
  description: rtc sntp
    application
  name: rtc_sntp
common:
  tags: introduction
  integration_platforms:
    - native_posix
  harness: console
  harness_config:
    type: one_line
    regex:
      - "RTC SNTP! (.*)"
tests:
  sample.basic.helloworld:
    tags: introduction
```

## prj.conf
```kconfig
#
# prj.conf
#
###############################################################################
# SYSTEM
CONFIG_LOG=y
CONFIG_LOG_MODE_DEFERRED=y
CONFIG_COMMON_LIBC_MALLOC_ARENA_SIZE=16384

###############################################################################
# PERIPHERALS
CONFIG_GPIO=y

###############################################################################
# WIFI
CONFIG_WIFI=y
CONFIG_INIT_STACKS=y
CONFIG_NET_L2_WIFI_MGMT=y

CONFIG_NETWORKING=y
CONFIG_NET_IPV4=y
CONFIG_NET_IPV6=n
CONFIG_NET_UDP=y
CONFIG_NET_TCP=y
CONFIG_DNS_RESOLVER=y
CONFIG_DNS_RESOLVER_AI_MAX_ENTRIES=10

CONFIG_NET_SOCKETS=y
# CONFIG_HTTP_CLIENT=y

# Use DHCP for IPv4
CONFIG_NET_DHCPV4=y

# Or assign a static IP address (useful for testing)
# Following line must be enabled, otherwise WiFi connection fails with -1.
CONFIG_NET_CONFIG_SETTINGS=y
#CONFIG_NET_CONFIG_NEED_IPV4=y
#CONFIG_NET_CONFIG_MY_IPV4_ADDR="192.168.0.12"
#CONFIG_NET_CONFIG_MY_IPV4_GW="192.168.0.254"
#CONFIG_NET_CONFIG_NEED_IPV6=y
#CONFIG_NET_CONFIG_MY_IPV6_ADDR="fe80::100"

# Enabling logging can be helpful for debugging
#CONFIG_NET_LOG=y
#CONFIG_WIFI_LOG_LEVEL_ERR=y
#CONFIG_NET_IPV6_LOG_LEVEL_DBG=y=\\\\\\\\\\\\\\\\\\\
CONFIG_NET_TX_STACK_SIZE=2048
CONFIG_NET_RX_STACK_SIZE=2048
CONFIG_NET_PKT_RX_COUNT=10
CONFIG_NET_PKT_TX_COUNT=10
CONFIG_NET_BUF_RX_COUNT=20
CONFIG_NET_BUF_TX_COUNT=20
CONFIG_NET_MAX_CONTEXTS=10

# Added to prevent error with missing #include <ethernet/eth_stats.h> for esp_wifi_drv.c
# Adding this line will cause CMAKE Warning: No SOURCES given to Zephyr library: drivers__ethernet
# Just ignore.
CONFIG_NET_L2_ETHERNET=y

CONFIG_DNS_SERVER_IP_ADDRESSES=y
CONFIG_DNS_SERVER1="8.8.8.8"

CONFIG_DNS_RESOLVER=y
CONFIG_DNS_RESOLVER_ADDITIONAL_BUF_CTR=2
CONFIG_SNTP=y
```

## boards/esp32.conf
```kconfig
# CONFIG_ESP_HEAP_MEM_POOL_REGION_1_SIZE=100000
# CONFIG_ESP_HEAP_SEARCH_ALL_REGIONS=n
# CONFIG_ESP_SPIRAM=y
# CONFIG_ESP_HEAP_MIN_EXTRAM_THRESHOLD=2048
# CONFIG_HEAP_MEM_POOL_SIZE=98304
# CONFIG_ESP32_WIFI_NET_ALLOC_SPIRAM=y
```

## boards/esp32.overlay
```dts
/ {
    leds {
        compatible = "gpio-leds";
        info_led: info_led {
            gpios = <&gpio0 2 GPIO_ACTIVE_HIGH>;
        };
    };
};

&wifi {
	status = "okay";
};
```

## src/main.c
```c
/*
 * Created by Trafficode in 2023.
 */
#include <inttypes.h>
#include <stdint.h>
#include <time.h>
#include <zephyr/device.h>
#include <zephyr/drivers/gpio.h>
#include <zephyr/kernel.h>
#include <zephyr/logging/log.h>
#include <zephyr/net/net_config.h>
#include <zephyr/net/net_event.h>
#include <zephyr/net/sntp.h>

#include "wifi_net.h"
#include "config_wifi.h"

LOG_MODULE_REGISTER(MAIN, LOG_LEVEL_DBG);

static const struct gpio_dt_spec InfoLed =
    GPIO_DT_SPEC_GET(DT_NODELABEL(info_led), gpios);

static int64_t UptimeSyncMs = 0;
static int64_t SntpSyncSec = 0;

static int64_t rtc_time_get(void) {
    int64_t sec_elapsed = (k_uptime_get() - UptimeSyncMs) / 1000;
    return (SntpSyncSec + sec_elapsed);
}

static int32_t rtc_time_sync(void) {
    int32_t rc = 0;
    struct sntp_time sntp_time = {0};

    rc = sntp_simple("time.google.com", 2000, &sntp_time);
    if (0 == rc) {
        SntpSyncSec = (int64_t)sntp_time.seconds;
        UptimeSyncMs = k_uptime_get();
    } else {
        LOG_ERR("Failed to acquire SNTP, code %d", rc);
    }

    return (rc);
}

int main(void) {
    LOG_INF("Board: %s", CONFIG_BOARD);
    LOG_INF("sys_clock_hw_cycles_per_sec = %u", sys_clock_hw_cycles_per_sec());

    if (!device_is_ready(InfoLed.port)) {
        LOG_ERR("GPIO0 not ready");
        return (0);
    }

    int32_t ret = gpio_pin_configure_dt(&InfoLed, GPIO_OUTPUT_ACTIVE);
    if (0 != ret) {
        LOG_ERR("gpio configuration failed");
        return (0);
    }

    /* Wait till wifi connection established */
    wifi_net_init(WIFI_SSID, WIFI_PASS);

    int32_t rtc_first_sync_rc = rtc_time_sync();
    while (0 != rtc_first_sync_rc) {
        rtc_first_sync_rc = rtc_time_sync();
        k_sleep(K_SECONDS(4));
    }

    int64_t last_sync_uptime = k_uptime_get();
    while (1) {
        k_sleep(K_SECONDS(1));
        gpio_pin_toggle_dt(&InfoLed);

        int64_t uptime_now = k_uptime_get();
        if (60 * 1000 < uptime_now - last_sync_uptime) {
            time_t now = rtc_time_get();
            struct tm now_tm;
            gmtime_r(&now, &now_tm);
            LOG_INF("RTC %u/%u/%u %02u:%02u:%02u", now_tm.tm_mday,
                    1 + now_tm.tm_mon, 1900 + now_tm.tm_year, now_tm.tm_hour,
                    now_tm.tm_min, now_tm.tm_sec);

            struct sntp_time sntp_time = {0};
            int32_t rc = sntp_simple("time.google.com", 2000, &sntp_time);
            if (0 == rc) {
                int64_t sntp_ts = (int64_t)sntp_time.seconds;
                gmtime_r(&sntp_ts, &now_tm);
                LOG_INF("UTC %u/%u/%u %02u:%02u:%02u", now_tm.tm_mday,
                        1 + now_tm.tm_mon, 1900 + now_tm.tm_year,
                        now_tm.tm_hour, now_tm.tm_min, now_tm.tm_sec);
            } else {
                LOG_ERR("Failed to acquire SNTP, code %d", rc);
            }
            last_sync_uptime = uptime_now;
        }
    }
}

/* ---------------------------------------------------------------------------
 * end of file
 * --------------------------------------------------------------------------*/
```

## inc/wifi_net.h
```c
/* ---------------------------------------------------------------------------
 *  wifi
 * ---------------------------------------------------------------------------
 *  Name: wifi_net.h
 * --------------------------------------------------------------------------*/
#ifndef WIFI_NET_H_
#define WIFI_NET_H_

void wifi_net_init(char *ssid, char *passwd);

#endif /* WIFI_NET_H_ */
/* ---------------------------------------------------------------------------
 * end of file
 * --------------------------------------------------------------------------*/
```

## src/wifi_net.c
```c
/* ---------------------------------------------------------------------------
 *  wifi
 * ---------------------------------------------------------------------------
 *  Name: wifi_net.c
 * --------------------------------------------------------------------------*/
#include "wifi_net.h"

#include <errno.h>
#include <zephyr/kernel.h>
#include <zephyr/logging/log.h>
#include <zephyr/net/net_event.h>
#include <zephyr/net/net_if.h>
#include <zephyr/net/wifi_mgmt.h>

LOG_MODULE_REGISTER(WIFI, LOG_LEVEL_DBG);

static K_SEM_DEFINE(wifi_connected, 0, 1);
static K_SEM_DEFINE(ipv4_address_obtained, 0, 1);

static struct net_mgmt_event_callback wifi_cb;
static struct net_mgmt_event_callback ipv4_cb;

static void handle_wifi_connect_result(struct net_mgmt_event_callback *cb) {
    const struct wifi_status *status = (const struct wifi_status *)cb->info;

    if (status->status) {
        LOG_INF("Connection request failed (%d)", status->status);
    } else {
        LOG_INF("Connected");
        k_sem_give(&wifi_connected);
    }
}

static void handle_wifi_disconnect_result(struct net_mgmt_event_callback *cb) {
    const struct wifi_status *status = (const struct wifi_status *)cb->info;

    if (status->status) {
        LOG_INF("Disconnection request (%d)", status->status);
    } else {
        LOG_INF("Disconnected");
        k_sem_take(&wifi_connected, K_NO_WAIT);
    }
}

static void handle_ipv4_result(struct net_if *iface) {
    int i = 0;

    for (i = 0; i < NET_IF_MAX_IPV4_ADDR; i++) {
        char buf[NET_IPV4_ADDR_LEN];

        if (iface->config.ip.ipv4->unicast[i].addr_type != NET_ADDR_DHCP) {
            continue;
        }

        LOG_INF("IPv4 address: %s",
                net_addr_ntop(
                    AF_INET, &iface->config.ip.ipv4->unicast[i].address.in_addr,
                    buf, sizeof(buf)));
        LOG_INF("Subnet: %s",
                net_addr_ntop(AF_INET, &iface->config.ip.ipv4->netmask, buf,
                              sizeof(buf)));
        LOG_INF("Router: %s", net_addr_ntop(AF_INET, &iface->config.ip.ipv4->gw,
                                            buf, sizeof(buf)));
    }

    k_sem_give(&ipv4_address_obtained);
}

static void wifi_mgmt_event_handler(struct net_mgmt_event_callback *cb,
                                    uint32_t mgmt_event, struct net_if *iface) {
    switch (mgmt_event) {
        case NET_EVENT_WIFI_CONNECT_RESULT:
            handle_wifi_connect_result(cb);
            break;

        case NET_EVENT_WIFI_DISCONNECT_RESULT:
            handle_wifi_disconnect_result(cb);
            break;

        case NET_EVENT_IPV4_ADDR_ADD:
            handle_ipv4_result(iface);
            break;

        default:
            break;
    }
}

static void wifi_status(void) {
    struct net_if *iface = net_if_get_default();

    struct wifi_iface_status status = {0};

    if (net_mgmt(NET_REQUEST_WIFI_IFACE_STATUS, iface, &status,
                 sizeof(struct wifi_iface_status))) {
        LOG_INF("WiFi Status Request Failed\n");
    }

    if (status.state >= WIFI_STATE_ASSOCIATED) {
        LOG_INF("SSID: %-32s", status.ssid);
        LOG_INF("Band: %s", wifi_band_txt(status.band));
        LOG_INF("Channel: %d", status.channel);
        LOG_INF("Security: %s", wifi_security_txt(status.security));
        LOG_INF("RSSI: %d", status.rssi);
    }
}

void wifi_net_init(char *ssid, char *passwd) {
    net_mgmt_init_event_callback(
        &wifi_cb, wifi_mgmt_event_handler,
        NET_EVENT_WIFI_CONNECT_RESULT | NET_EVENT_WIFI_DISCONNECT_RESULT);

    net_mgmt_init_event_callback(&ipv4_cb, wifi_mgmt_event_handler,
                                 NET_EVENT_IPV4_ADDR_ADD);

    net_mgmt_add_event_callback(&wifi_cb);
    net_mgmt_add_event_callback(&ipv4_cb);

    struct net_if *iface = net_if_get_default();
    struct wifi_connect_req_params wifi_params = {0};
    wifi_params.ssid = ssid;
    wifi_params.psk = passwd;
    wifi_params.ssid_length = strlen(ssid);
    wifi_params.psk_length = strlen(passwd);
    wifi_params.channel = WIFI_CHANNEL_ANY;
    wifi_params.security = WIFI_SECURITY_TYPE_PSK;
    wifi_params.band = WIFI_FREQ_BAND_2_4_GHZ;
    wifi_params.mfp = WIFI_MFP_OPTIONAL;

    LOG_INF("Connecting to SSID: %s", wifi_params.ssid);

    if (net_mgmt(NET_REQUEST_WIFI_CONNECT, iface, &wifi_params,
                 sizeof(struct wifi_connect_req_params))) {
        LOG_INF("WiFi Connection Request Failed");
    }

    k_sem_take(&wifi_connected, K_FOREVER);
    wifi_status();
    k_sem_take(&ipv4_address_obtained, K_FOREVER);
    LOG_INF("Ready...\n");
}

/* ---------------------------------------------------------------------------
 * end of file
 * --------------------------------------------------------------------------*/
```
